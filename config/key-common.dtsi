/ {
    // macros
    macros {
        mac_screen_sleep: mac_screen_sleep {
            label = "Put mac screen to sleep";
            compatible = "zmk,behavior-macro";
            #binding-cells = <0>;
            wait-ms = <0>;
            tap-ms = <10>;
            bindings
                = <&macro_press &kp LCTRL &kp LSHFT>
                , <&macro_tap &kp C_EJECT>
                , <&macro_release &kp LCTRL &kp LSHFT>
                ;
        };
    };
};
